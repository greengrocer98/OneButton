#include <dt-bindings/zmk/matrix_transform.h>

/ {
    chosen {
        zmk,kscan = &kscan0;
        zmk,matrix_transform = &default_transform;
    };

    default_transform: keymap_transform0 {
        compatible = "zmk,matrix-transform";
        columns = <1>; // Length of the "col-gpios" array
        rows = <1>; // Length of the "row-gpios" array
        map = < RC(0,0)>;
    };

    kscan0: kscan {
        compatible = "zmk,kscan-gpio-direct";
        wakeup-source;

        input-gpios = <&pro_micro 14 (GPIO_ACTIVE_LOW | GPIO_PULL_UP)>;
    };
};